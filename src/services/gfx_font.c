// gfx_font — kernel-side bitmap text for the graphics ABI (Phase 5.3b).
//
// Format-agnostic: glyphs are rasterised through gfx_set_pixel(), so the same
// gfx_draw_text() works on MONO_VLSB (OLED), RGB565 and GRAY4 framebuffers.
// This replaces the per-module 5x7 font tables that oled/eink each carried.

#include "loader/kernel_abi.h"
#include <stdint.h>

// 5x7 font, ASCII 0x20..0x7E. Each glyph is 5 column bytes; bit i (LSB) is the
// top row. Identical to the tables previously embedded in the display modules.
static const uint8_t s_font5x7_glyphs[] = {
    0x00,0x00,0x00,0x00,0x00, // (space)
    0x00,0x00,0x5F,0x00,0x00, // !
    0x00,0x07,0x00,0x07,0x00, // "
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    0x10,0x08,0x08,0x10,0x08, // ~
};

struct gfx_font {
    const char    *name;
    const uint8_t *glyphs;
    uint8_t        first;    // first ASCII code
    uint8_t        count;    // number of glyphs
    uint8_t        gw, gh;   // glyph width/height in pixels
    uint8_t        advance;  // horizontal advance (gw + spacing)
};

static const struct gfx_font s_font5x7 = {
    .name = "5x7", .glyphs = s_font5x7_glyphs,
    .first = 0x20, .count = 95, .gw = 5, .gh = 7, .advance = 6,
};

const gfx_font_t *gfx_font_get(const char *name)
{
    // Only one built-in font today; "6x8" is an alias (5x7 cell, 6px advance).
    (void)name;
    return &s_font5x7;
}

int gfx_draw_char(gfx_fb_t *fb, int x, int y, char c,
                  const gfx_font_t *f, uint32_t color)
{
    if (!fb || !f) return 0;

    uint8_t uc = (uint8_t)c;
    if (uc < f->first || uc >= (uint8_t)(f->first + f->count)) uc = ' ';
    const uint8_t *g = &f->glyphs[(uc - f->first) * f->gw];

    for (int col = 0; col < f->gw; col++) {
        uint8_t bits = g[col];
        for (int row = 0; row < f->gh; row++) {
            if (bits & (1u << row))
                gfx_set_pixel(fb, x + col, y + row, color);
        }
    }
    return f->advance;
}

int gfx_draw_text(gfx_fb_t *fb, int x, int y, const char *s,
                  const gfx_font_t *f, uint32_t color)
{
    if (!fb || !f || !s) return 0;

    int cx = x, cy = y;
    for (; *s; s++) {
        if (*s == '\n') {
            cx = x;
            cy += f->gh + 1;
            continue;
        }
        cx += gfx_draw_char(fb, cx, cy, *s, f, color);
    }
    return cx - x;
}
